## config/boards/arm/adv360/adv360_right_defconfig
```kconfig
#
# Copyright (c) 2021 Polarity Works
# SPDX-License-Identifier: MIT
#

CONFIG_SOC_SERIES_NRF52X=y
CONFIG_SOC_NRF52840_QIAA=y
CONFIG_BOARD_ADV360_RIGHT=y
CONFIG_ZMK_BLE=y
CONFIG_ZMK_SPLIT=y


# Enable MPU
CONFIG_ARM_MPU=y

# enable GPIO
CONFIG_GPIO=y



# Enable SPI
CONFIG_SPI=y
CONFIG_SPI_NRFX=y

# Enable writing to flash
CONFIG_USE_DT_CODE_PARTITION=y
CONFIG_MPU_ALLOW_FLASH_WRITE=y
CONFIG_NVS=y
CONFIG_SETTINGS_NVS=y
CONFIG_FLASH=y
CONFIG_FLASH_PAGE_LAYOUT=y
CONFIG_FLASH_MAP=y

# Enable 32kHz crystal
CONFIG_CLOCK_CONTROL_NRF_K32SRC_XTAL=y
CONFIG_CLOCK_CONTROL_NRF_K32SRC_500PPM=y

CONFIG_ZMK_RGB_UNDERGLOW=y
CONFIG_ZMK_RGB_UNDERGLOW_EXT_POWER=y
CONFIG_ZMK_RGB_UNDERGLOW_ON_START=y
CONFIG_ZMK_RGB_UNDERGLOW_EFF_START=4
CONFIG_ZMK_RGB_UNDERGLOW_AUTO_OFF_IDLE=y

# Use the STRIP config specific to the LEDs you're using
CONFIG_WS2812_STRIP=y
CONFIG_BT_CTLR_TX_PWR_PLUS_8=y
CONFIG_PWM=y
CONFIG_LED_PWM=y
CONFIG_ZMK_BACKLIGHT=y
CONFIG_ZMK_BACKLIGHT_AUTO_OFF_IDLE=y

CONFIG_ZMK_HID_REPORT_TYPE_NKRO=y
CONFIG_ZMK_HID_CONSUMER_REPORT_USAGES_BASIC=y

CONFIG_USB_DEVICE_VID=0x29EA
CONFIG_USB_DEVICE_PID=0x0362
CONFIG_USB_DEVICE_MANUFACTURER="Kinesis Corporation"

# Turn on logging, and set ZMK logging to debug output
CONFIG_LOG=y
CONFIG_ZMK_USB_LOGGING=y


CONFIG_BUILD_OUTPUT_UF2=y

################################################################################
# For more pleasant PC debugging: increase the idle timeout from 30s to 5m,
# to ensure the num lock LED will turn on (on the right key block). Otherwise,
# the right key block goes into power save mode and won’t show the num lock LED
################################################################################

# Increase idle timeout from the default of 30s (= 30000ms) to 5 minutes (= 300s).
CONFIG_ZMK_IDLE_TIMEOUT=300000

################################################################################
# For lowest-possible input latency:
# https://michael.stapelberg.ch/posts/2021-05-08-keyboard-input-latency-qmk-kinesis/
################################################################################

# eager debounce: https://zmk.dev/docs/features/debouncing#eager-debouncing
CONFIG_ZMK_KSCAN_DEBOUNCE_PRESS_MS=0
CONFIG_ZMK_KSCAN_DEBOUNCE_RELEASE_MS=5
```
